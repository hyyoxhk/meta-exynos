## conf/layer.conf
```bitbake
# We have a conf and classes directory, add to BBPATH
BBPATH .= ":${LAYERDIR}"

# We have recipes-* directories, add to BBFILES
BBFILES += "${LAYERDIR}/recipes-*/*/*.bb \
            ${LAYERDIR}/recipes-*/*/*.bbappend"

BBFILE_COLLECTIONS += "meta-exynos"
BBFILE_PATTERN_meta-exynos = "^${LAYERDIR}/"
BBFILE_PRIORITY_meta-exynos = "6"

LAYERDEPENDS_meta-exynos = "core"
LAYERSERIES_COMPAT_meta-exynos = "kirkstone"
LAYERVERSION_meta-exynos = "1"
```

## conf/machine/exynos.conf
```bitbake
#@TYPE: Machine
#@NAME: exynos
#@DESCRIPTION: Configuration for iTop-4412 SCP 1G boards (elite)

include conf/machine/include/machine-extlinux-config.inc

# Chip architecture
DEFAULTTUNE = "cortexa9thf-neon"
require conf/machine/include/arm/armv7a/tune-cortexa9.inc

# support linux
PREFERRED_PROVIDER_virtual/kernel = "linux-exynos"

# linux defconfig
KBUILD_DEFCONFIG = "itop_defconfig"

# kernel image type
KERNEL_IMAGETYPE = "uImage"

# KERNEL_LOADADDR => make uImage LOADADDR=0x4007d000
KERNEL_LOADADDR = "0x4007d000"

# support u-boot
EXTRA_IMAGEDEPENDS += "u-boot-exynos"
PREFERRED_PROVIDER_virtual/bootloader = "u-boot-exynos"

# u-boot defconfig
UBOOT_MACHINE = "itop_defconfig"

# u-boot duffix
UBOOT_SUFFIX = "bin"

# device tree
ITOP_DEVICETREE = "exynos4412-itop-elite"
UBOOT_DEVICETREE   = "${ITOP_DEVICETREE}"
KERNEL_DEVICETREE  = "${ITOP_DEVICETREE}.dtb"

# Default FSTYPES requested
IMAGE_FSTYPES ?= "tar.xz ext4"

# MACHINE_FEATURES += "bluetooth"
# MACHINE_FEATURES += "wifi"
# MACHINE_FEATURES += "alsa"
MACHINE_FEATURES = "usbhost usbgadget ext2"

# Default serial consoles (TTYs) to enable using getty
# Before kernel 4.18, serial console are ttyS3 but after is ttySAC2
SERIAL_CONSOLES = "115200;ttySAC2"
SERIAL_CONSOLE = "115200 ttySAC2"

IMAGE_BOOT_FILES ?= " \
    ${KERNEL_IMAGETYPE} \
    ${KERNEL_DEVICETREE} \
"

WKS_FILE_DEPENDS ?= " \
    u-boot-exynos \
"
IMAGE_FSTYPES += "wic"
WKS_FILE += "sdcard-itop-scp-1GB.wks.in"

# UBOOT_SOURCE_SELECTION = "tarball"
```

## conf/machine/include/machine-extlinux-config.inc
```bitbake
UBOOT_EXTLINUX = "1"

# Define extlinux console
UBOOT_EXTLINUX_CONSOLE = "console=${@d.getVar('SERIAL_CONSOLE').split()[1]},${@d.getVar('SERIAL_CONSOLE').split()[0]}"
# Define extlinux labels
UBOOT_EXTLINUX_LABELS = "exynos4412-itop-elite-sdcard"
# Define extlinux timeout
UBOOT_EXTLINUX_TIMEOUT = "20"
# Define additional kernel arguments
UBOOT_EXTLINUX_KERNEL_ARGS = "quiet"

UBOOT_EXTLINUX_ROOT = "LABEL=${LABEL} root=${mmcroot}"
UBOOT_EXTLINUX_KERNEL_IMAGE:exynos4412-itop-elite-sdcard = "/uImage"
UBOOT_EXTLINUX_FDT:exynos4412-itop-elite-sdcard = "/exynos4412-itop-elite.dtb"
UBOOT_EXTLINUX_INITRD = "/initrd.img"
```

## wic/sdcard-itop-scp-1GB.wks
```
# short-description: Create SD card image with a boot partition (1GB)
# long-description: Creates a partitioned SD card image (1GB)
#
#  ------- --------- -------------- -------------
# |   fsbl | u-boot  |     bootfs   |    rootfs |
#  ------- --------- -------------- -------------
# ^       ^         ^              ^             ^
# |       |         |              |             |
# 0    25kB       2MB           64MB         768M
#
part ssbl  --source rawcopy --fstype=ext4 --fsoptions "noauto" --sourceparams="file=u-boot-exynos.bin" --ondisk mmcblk --fixed-size 2048K --align 25
part /boot --source bootimg-partition --sourceparams="loader=u-boot" --ondisk mmcblk --fstype=vfat --label bootfs --active --fixed-size 64M
part / --source rootfs --ondisk mmcblk --fstype=ext4 --label rootfs --fixed-size 768M

bootloader --ptable msdos --configfile="${DEPLOY_DIR_IMAGE}/extlinux.conf"
```
